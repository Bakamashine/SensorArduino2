#include <Arduino.h>
#include "ui.h"
#include "error.h"
#include "settings.h"
#include "page.h"
#include <stdarg.h>
#include "constants/ui.h"
#include "constants/constants.h"
#include "menuUi.h"
#include "helperUi.h"

// 'Capture', 70x40px
const unsigned char epd_bitmap_Capture[] PROGMEM = {
    0xff, 0xff, 0xff, 0xff, 0xff, 0xff, 0xff, 0xff, 0x3f, 0xff, 0xff, 0xff, 0xff, 0xff, 0xff, 0xff,
    0xff, 0x3f, 0xff, 0xff, 0xff, 0xff, 0xff, 0xff, 0xff, 0xff, 0x3f, 0xff, 0xff, 0xff, 0xff, 0xff,
    0xff, 0xff, 0xff, 0x3f, 0xff, 0xff, 0xff, 0xff, 0xff, 0xff, 0xff, 0xff, 0x3f, 0xff, 0xff, 0xff,
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    0x7f, 0xff, 0xff, 0xff, 0xff, 0xff, 0xff, 0x3f};

template <typename T>
UI<T>::UI()
    : T(U8G2_R0, /* reset=*/U8X8_PIN_NONE)
{
  tempText[0] = '\0';
  deltaText[0] = '\0';
  voltText[0] = '\0';
  userTempText[0] = '\0';

  menuUI = new MenuUI(this);
}

template <typename T>
MenuUI &UI<T>::getMenuUI()
{
  return *menuUI;
}

template <typename T>
void UI<T>::setFloatText(char *buf, size_t size, const char *label, float v)
{
  if (v < 0)
    v = -v;
  int whole = (int)v;
  int frac = (int)(v * 100) % 100;

  setText(buf, size, "%s: %d.%02d", label, whole, frac);
}

template <typename T>
void UI<T>::setTemperature(float temp)
{
  this->temperature = temp;
  this->setFloatText(tempText, sizeof(tempText), "T", temp);
}

template <typename T>
float UI<T>::getTemperature()
{
  return temperature;
}

template <typename T>
void UI<T>::setVolt(float volt)
{
  voltage = volt;
  this->setFloatText(voltText, sizeof(voltText), "V", volt);
}

template <typename T>
void UI<T>::main()
{
  setText(userTempText, sizeof(userTempText), "UT: %d",
          Settings::getUserTemp());
  setText(deltaText, sizeof(deltaText), "Delta: %d", Settings::getHysteresis());
  this->drawStr(TEMP_X, TEMP_Y, tempText);
  this->drawStr(VOLT_X, VOLT_Y, voltText);
  this->drawStr(HYSTERESIS_X, HYSTERESIS_Y, deltaText);
  this->drawStr(USERTEMP_X, USERTEMP_Y, userTempText);
  snprintf(burnerText, sizeof(burnerText), "Burner: %s", Settings::getBurnerStatus() ? "ON" : "OFF");
  // error overlay, not a replacement screen
  if (Settings::getErrorStatus())
  {
    this->drawStr(BURNER_X, BURNER_Y, Error::getErrorMessage(errorCode));
  }
  else
  {
    this->drawStr(BURNER_X, BURNER_Y, burnerText);
  }
}

template <typename T>
void UI<T>::draw()
{
  this->firstPage();
  do
  {
    this->setFont(FONT);
    switch (Page::getCurrentPage())
    {
    case MAIN_PAGE:
      main();
      break;
    case SELECT_SETTINGS:
      menuUI->draw();
      break;
    default:
      break;
    }
  } while (this->nextPage());
}

template <typename T>
void UI<T>::setError(int code)
{
  errorCode = code;
}

template <typename T>
void UI<T>::removeError()
{
  errorCode = 0;
}

template <typename T>
void UI<T>::initDelta()
{
  setText(deltaText, sizeof(deltaText), "Delta: %d", Settings::getHysteresis());
}

template <typename T>
void UI<T>::userTempInit()
{
  setText(userTempText, sizeof(userTempText), "UT: %d", Settings::getUserTemp());
}

template <typename T>
void UI<T>::initUI()
{
  setTemperature(0);
  // setVolt(0);
  initDelta();
  userTempInit();
}

template <typename T>
void UI<T>::startWindow()
{
  this->firstPage();
  do
  {
    this->setFont(FONT);
    drawCentered("Factory IRBIS", 0, 25);
    this->drawXBMP(CENTER_X / 2, CENTER_Y / 2, 70, 40, epd_bitmap_Capture);
  } while (this->nextPage());
  delay(4000);
}

template <typename T>
int UI<T>::drawCentered(const char *text, int padding_top, int padding_bottom, int padding_left, int padding_right)
{
  int x = (OLED_WIDTH - this->getStrWidth(text)) / 2;
  int y = (OLED_HEIGHT + this->getFontAscent()) / 2;
  this->drawStr(x + padding_left - padding_right, y + padding_top - padding_bottom, text);
  return y;
}

template class UI<OLED_CLASS>;